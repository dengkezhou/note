## bms/drivers/hwmon/Kconfig
```kconfig
config DRV_HWMON
	bool "hwmon driver support"
	default n
	help:
		enable hwmon driver
```

## bms/drivers/i2s/Kconfig
```kconfig
config DRV_I2S
	bool "i2s driver support"
	default n
	help
		enable i2s driver

config CDNS_I2S_SC
	bool "cadence i2s sc driver support"
	help
		Cadence I2S SC driver support

config CDNS_I2S_MC
	bool "cadence i2s mc driver support"
	help
		Cadence I2S MC driver support

source "drivers/i2s/es8388/Kconfig"
```

## bms/drivers/i2s/es8388/Kconfig
```kconfig
config DRV_CODEC_ES8388
	bool "codec es8388 driver support"
	default n
	help
		enable codec es8388 driver
```

## bms/drivers/irqchip/Kconfig
```kconfig
config DRV_IRQCHIP
	bool "irqchip driver support"
	default n
	help:
		enable irqchip

if DRV_IRQCHIP
choice
		prompt "Irq Controller"
		default PLIC

config PLIC
		bool "plic controller"
		help
			plic irq controller

config CLIC
		bool "clic controller"
		help
			clic irq controller

endchoice
endif
```

## bms/drivers/lpddr4/Kconfig
```kconfig
config DRV_LPDDR4
	bool "lpddr4 driver support"
	default n
	help:
	  enable lpddr4
```

## bms/drivers/pmic/Kconfig
```kconfig
config DRV_PMIC
	bool "pmic driver support"
	default n
	help:
		enable pmic driver
```

## bms/drivers/pufcc/Kconfig
```kconfig
config DRV_PUFCC
	bool

config DRV_PUFSECURITY
	bool "pufcc driver support"
	default n
	select DRV_PUFCC
	help:
		enable pufcc
```

## bms/drivers/spi_flash/Kconfig
```kconfig
config DRV_SPI_FLASH
	bool "spi flash driver support"
	default n
	help:
		enable spi flash
```

## bms/drivers/vdec/Kconfig
```kconfig
config DRV_VDEC
	bool "vdec driver support"
	default n
	help
		enable vdec support

config DRV_VDEC_H264
	bool "VDEC H264 Subsystem"
	depends on DRV_VDEC
	default n
	help
		VDEC H264 Subsystem

config DRV_VDEC_HEVC
	bool "VDEC HEVC Subsystem"
	depends on DRV_VDEC
	default n
	help
		VDEC HEVC Subsystem

config DRV_VDEC_JPEG
	bool "VDEC JPEG Subsystem"
	depends on DRV_VDEC
	default n
	help
		VDEC JPEG Subsystem
```

## bms/drivers/venc/Kconfig
```kconfig
config DRV_VENC
    bool "video encode driver support"
    default n
    help
        enable video encode driver
```
