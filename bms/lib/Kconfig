## bms/lib/Kconfig
```kconfig
source "lib/command/Kconfig"
source "lib/math/Kconfig"
source "lib/shell/Kconfig"
source "lib/stdlib/Kconfig"
source "lib/console/Kconfig"
source "lib/crypto/Kconfig"
source "lib/common/Kconfig"
source "lib/interrupt/Kconfig"
source "lib/fatfs/Kconfig"
source "lib/rtlfs/Kconfig"
source "lib/rtl/Kconfig"
source "lib/freertos/Kconfig"
source "lib/sbi/Kconfig"
```

## bms/lib/fatfs/Kconfig
```kconfig
config LIB_FATFS
	bool "fatfs support"
	default n
	select DRV_SDMMC
	help:
		enable fatfs

config FATFS_MMC_IF
	hex "FATFS MMC Interface"
	default 0x1
	depends on LIB_FATFS

config FS_API_WRAPPER
	bool "enable fs wrapper api"
	depends on LIB_FATFS && !LIB_RTLFS
	default y
```

## bms/lib/freertos/Kconfig
```kconfig
config LIB_FREERTOS
	bool "freertos support"
	default n
	help:
		enable freertos
```

## bms/lib/interrupt/Kconfig
```kconfig
config LIB_INTERRUPT
	bool "interrupt support"
	default n
	help:
		enable interrupt
```

## bms/lib/rtlfs/Kconfig
```kconfig
config LIB_RTLFS
	bool "rtlfs support"
	default n
	help:
		enable rtlfs

config RTLFS_LOCATION
	hex "rtlfs location"
	default 0x140000000
	depends on LIB_RTLFS
	help:
		rtlfs location
```

## bms/testbench/Kconfig
```kconfig
source "testbench/cpu/Kconfig"
source "testbench/dma/Kconfig"
source "testbench/irq/Kconfig"
source "testbench/rtlfs/Kconfig"
source "testbench/timer/Kconfig"
source "testbench/i2c/Kconfig"
source "testbench/skull/Kconfig"
source "testbench/task/Kconfig"
source "testbench/wdt/Kconfig"
source "testbench/uart/Kconfig"
source "testbench/eth/Kconfig"
source "testbench/i2s/Kconfig"
source "testbench/vdec/Kconfig"
source "testbench/sdmmc/Kconfig"
source "testbench/sysm/Kconfig"
source "testbench/drd/Kconfig"
source "testbench/rtc/Kconfig"
source "testbench/spi/Kconfig"
source "testbench/xspi/Kconfig"
source "testbench/mu/Kconfig"
source "testbench/pwm/Kconfig"
source "testbench/pvt/Kconfig"
source "testbench/cae/Kconfig"
source "testbench/pufcc/Kconfig"
source "testbench/ddr/Kconfig"
source "testbench/rxa/Kconfig"
source "testbench/lpddr4/Kconfig"
source "testbench/ids/Kconfig"
source "testbench/npu/Kconfig"
source "testbench/dmic/Kconfig"
source "testbench/venc/Kconfig"
source "testbench/pmic/Kconfig"
source "testbench/fatfs/Kconfig"
source "testbench/dmic_pcm/Kconfig"
source "testbench/hwmon/Kconfig"
```

## bms/testbench/cae/Kconfig
```kconfig
config TBH_CAE
	bool "testbench cae support"
	default n
	help:
		enable testbench cae
```

## bms/testbench/cpu/Kconfig
```kconfig
config TBH_CPU
	bool

config TBH_E906
	bool "testbench e906 support"
	default n
	select TBH_CPU
	help:
		enable testbench e906

config TBH_C920
	bool "testbench c920 support"
	default n
	select TBH_CPU
	help:
		enable testbench c920
```

## bms/testbench/ddr/Kconfig
```kconfig
config TBH_DDR
	bool "testbench ddr support"
	default n
	help:
		enable testbench ddr
```

## bms/testbench/dma/Kconfig
```kconfig
config TBH_DMA
	bool "testbench dma support"
	default n
	help:
		enable testbench dma
```

## bms/testbench/dmic/Kconfig
```kconfig
config TBH_DMIC
	bool "testbench dmic support"
	default n
	help:
		enable testbench dmic
```

## bms/testbench/dmic_pcm/Kconfig
```kconfig
config TBH_DMIC_PCM
	bool "testbench dmic_pcm support"
	default n
	help:
		enable testbench dmic_pcm
```

## bms/testbench/drd/Kconfig
```kconfig
config TBH_DRD
	bool "testbench drd support"
	default n
	help:
		enable testbench drd
```

## bms/testbench/eth/Kconfig
```kconfig
config TBH_ETH
	bool "testbench eth support"
	default n
	help:
		enable testbench eth
```

## bms/testbench/fatfs/Kconfig
```kconfig
config TBH_FATFS
	bool "testbench fatfs support"
	default n
	select DRV_PUFCC
	select LIB_FATFS
	help:
		enable testbench fatfs
```

## bms/testbench/hwmon/Kconfig
```kconfig
config TBH_HWMON
	bool "testbench hwmon support"
	default n
	help:
		enable testbench hwmon
```
