## bms/testbench/i2c/Kconfig
```kconfig
config TBH_I2C
	bool "testbench i2c support"
	default n
	help:
		enable testbench i2c
```

## bms/testbench/i2s/Kconfig
```kconfig
config TBH_I2S
	bool "testbench i2s support"
	default n
	help:
		enable testbench i2s
```

## bms/testbench/ids/Kconfig
```kconfig
config TBH_IDS
	bool "testbench ids support"
	default n
	help:
		enable testbench ids

config TBH_IDS_MEDIA
	bool "testbench media support"   
	depends on TBH_IDS
```

## bms/testbench/irq/Kconfig
```kconfig
config TBH_IRQ
	bool "testbench irq support"
	default n
	help:
		enable testbench irq
```

## bms/testbench/lpddr4/Kconfig
```kconfig
config TBH_LPDDR4
	bool "testbench lpddr4 support"
	default n
	help:
		enable testbench lpddr4
```

## bms/testbench/mu/Kconfig
```kconfig
config TBH_MU
	bool "testbench mu support"
	default n
	help:
		enable testbench mu
```

## bms/testbench/npu/Kconfig
```kconfig
config TBH_NPU
	bool "testbench npu support"
	default n
	help:
		enable testbench npu
```

## bms/testbench/pmic/Kconfig
```kconfig
config TBH_PMIC
	bool "testbench pmic support"
	default n
	help:
		enable testbench pmic
```

## bms/testbench/pufcc/Kconfig
```kconfig
config TBH_PUFCC
	bool

config TBH_PUFSECURITY 
	bool "testbench pufcc support"
	default n
	select TBH_PUFCC
	help:
		enable testbench pufcc
```

## bms/testbench/pvt/Kconfig
```kconfig
config TBH_PVT
	bool "testbench pvt support"
	default n
	help:
		enable testbench pvt
```

## bms/testbench/pwm/Kconfig
```kconfig
config TBH_PWM
	bool "testbench pwm support"
	default n
	help:
		enable testbench pwm
```

## bms/testbench/rtc/Kconfig
```kconfig
config TBH_RTC
	bool "testbench rtc support"
	default n
	help:
		enable testbench rtc
```

## bms/testbench/rtlfs/Kconfig
```kconfig
config TBH_RTLFS
	bool "testbench rtlfs support"
	default n
	help:
		enable testbench rtlfs
```

## bms/testbench/rxa/Kconfig
```kconfig
config TBH_RXA
	bool "testbench rxa support"
	default n
	help:
		enable testbench rxa

if TBH_RXA
config RANDOMX_MINING
	bool "Randomx Mining support"
	default n
	help:
	  enable randomx mining
endif
```

## bms/testbench/sdmmc/Kconfig
```kconfig
config TBH_SDMMC
	bool "testbench sdmmc support"
	default n
	help
		enable testbench sdmmc
```

## bms/testbench/skull/Kconfig
```kconfig
config TBH_SKULL
	bool "testbench skull support"
	default n
	help:
		enable testbench skull
```

## bms/testbench/spi/Kconfig
```kconfig
config TBH_SPI
	bool "testbench spi support"
	default n
	help:
		enable testbench spi
```

## bms/testbench/sysm/Kconfig
```kconfig
config TBH_SYSM
	bool "testbench sysm support"
	default n
	help:
		enable testbench sysm
```

## bms/testbench/task/Kconfig
```kconfig
config TBH_TASK
	bool "testbench task support"
	default n
	help:
		enable testbench task
```

## bms/testbench/timer/Kconfig
```kconfig
config TBH_TIMER
	bool "testbench timer support"
	default n
	help:
		enable testbench timer
```

## bms/testbench/uart/Kconfig
```kconfig
config TBH_UART
	bool "testbench uart support"
	default n
	help:
		enable testbench uart
```

## bms/testbench/vdec/Kconfig
```kconfig
config TBH_VDEC
	bool "testbench vdec support"
	default n
	help
		enable testbench vdec
```

## bms/testbench/venc/Kconfig
```kconfig
config TBH_VENC
	bool "testbench video encode support"   
	default n
	help:
		enable testbench video encode


config TBH_VENC_LOCALCASE
	bool "testbench video encode localcase support"   
	depends on TBH_VENC


config TBH_VENC_SPEED_TEST
	bool "testbench video encode localcase speed test"   
	depends on TBH_VENC


config TBH_VENC_JOINT_TEST
	bool "testbench video encode localcase joint test"   
	depends on TBH_VENC
```

## bms/testbench/wdt/Kconfig
```kconfig
config TBH_WDT
	bool "testbench wdt support"
	default n
	help:
		enable testbench wdt
```

## bms/testbench/xspi/Kconfig
```kconfig
config TBH_XSPI
	bool "testbench xspi support"
	default n
	help:
		enable testbench xspi
```
