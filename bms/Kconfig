## bms/Kconfig
```kconfig
mainmenu "BareMetal System Configuration"

menu "Target options"

choice
	prompt "Target Architecture"
	default RISCV

config RISCV
	bool "risc-v"
	help
	  risc-v architecture

config ARM
	bool "arm"
	help
	  arm architecture
endchoice
	
if RISCV
choice
	prompt "Machine"
	default C920

config C920
	bool "c920"
	help
		T-head c920 core

config C906
	bool "c906"
	help
		T-head c906 core
	
config E906
	bool "e906"
	help
		T-head e906 core

config E902
	bool "e902"
	help
		T-head e902 core

endchoice

config RISCV_SMODE
	bool "run in supervisor mode"
	default n
	help
		run in supervisor mode

endif

if ARM
choice
	prompt "Machine"
	default Q3

config Q3
	bool "q3"
	help
		arm a9 core

endchoice
endif

config MACHINE
	string
	default "c920" if C920
	default "c906" if C906
	default "e906" if E906
	default "e902" if E902
	default "q3" if Q3

choice
	prompt "Target Mode"
	default COMPILE_SIM

config COMPILE_RTL
	bool "rtl"
	help
		RTL Test

config COMPILE_FPGA
	bool "fpga"
	help
		FPGA Test

config COMPILE_ASIC
	bool "asic"
	help
		ASIC Test

config COMPILE_SIM
	bool "cskysim"
	help
		Cskysim Test

config COMPILE_EVB
	bool "evb"
	help
		EVB Test

endchoice

config NR_CPUS
	int "CPU Max Cores"
	range 0 32
	default 4
	help
		cpu numbers

config COMPILE_ROM
	bool "compile as rom.bin"
	default n
	help
		compile rom.bin

if COMPILE_ROM
config BOOT_OTHER_CORE
	bool "boot other core to run soc.bin"
	default n
	help
		boot other core to run soc.bin
config DDR_INTERLEAVE
	bool "ddr interleave"
	default n
	help
		ddr interleave
config BOOTM
	depends on COMPILE_ASIC
	hex "set bootm"
	default 0x1
	help
		Set boom for asic to init ddr
		  - BOOTM_LPDDR4_DDR1_NO_INTLEAVE = 0xd,
		  - BOOTM_LPDDR4_NO_INTLEAVE = 0xf,
		  - BOOTM_LPDDR4_WITH_INTLEAVE = 0xe,
		  - BOOTM_DDR_NO_INTLEAVE = 0x1,
		  - BOOTM_DDR_WITH_INTLEAVE = 0x2,
		  - BOOTM_DDR1_NO_INTLEAVE = 0x3
config TB
	bool "rom.bin would run testbench"
	default n
	help
	  rom.bin would run testbench
endif

choice
	prompt "ASIC Test Platform"
	default ASIC_TEST_ON_EVB
	depends on COMPILE_ASIC

config ASIC_TEST_ON_FPGA
	bool "ASIC Test On FPGA"
	help
		ASIC Test On FPGA
config ASIC_TEST_ON_EVB
	bool "ASIC Test On EVB"
	help
		ASIC Test On EVB
endchoice

choice
	prompt "memory for running testbench"
	default TB_RUN_IRAM

config TB_RUN_DDR
	bool "ddr"
	help
		Testbench run in ddr

config TB_RUN_DDR1
	bool "ddr1"
	help
		Testbench run in ddr1

config TB_RUN_IRAM
	bool "iram"
	help
		Testbench run in iram

endchoice

config CACHE
	bool "support cache"
	depends on !TB_RUN_IRAM || !C920
	help
		support cache

config DCACHE
	bool "support d-cache"
	depends on CACHE
	help
		support d-cache
config ICACHE
	bool "support i-cache"
	depends on CACHE
	help
		support i-cache

config CACHE_LITE
	bool "Lite cache(Do not support invalid, clean and flush)"
	depends on CACHE && (ICACHE || DCACHE)
	help
		lite cache(support only enable & disable)

config L2CACHE
	depends on CACHE && !E906
	bool "support L2 cache"
	help
		support L2 cache

config MMU
	bool "support mmu"
	depends on !TB_RUN_IRAM || !C920
	help
	 support mmu

config SYSMAP
	bool "support reconfig sysmap"
	help
		support reconfig sysmap

choice
	prompt "Target System"
	default 64BIT

config 64BIT
	bool "64bit"
	help
		64bit system

config 32BIT
	bool "32bit"
	help
		32bit system

endchoice
config DDR_DATA_UNCACHEABLE
	bool "only cacheable text segment"
	help
		support data uncacheable

config CPU_CORES_TEST
	bool "cpu cores test"
	help
		support cpu cores test
endmenu

menuconfig COMPILE_DRV
  bool "BareMetal System Driver"
  default y
	help
		BareMetal System Driver

if COMPILE_DRV
source "drivers/Kconfig"
endif

menuconfig COMPILE_TBH
  bool "BareMetal System TestBench"
  default y
	help
		BareMetal System TestBench

if COMPILE_TBH
source "testbench/Kconfig"
endif

menuconfig COMPILE_LIB
  bool "BareMetal System Lib"
	default y
	help
		BareMetal System Libs

if COMPILE_LIB
source "lib/Kconfig"
endif

menuconfig COMPILE_ARCH
	bool "BareMetal System Arch"
	default y
	help
		BareMetal System Arch

if COMPILE_ARCH
source "arch/Kconfig"
endif
```

## bms/arch/Kconfig
```kconfig
if ARM
source "arch/arm/Kconfig"
endif
if RISCV
source "arch/riscv/Kconfig"
endif
```

## bms/arch/riscv/Kconfig
```kconfig
if CONFIG_C920
source "arch/riscv/c920/Kconfig"
endif
if CONFIG_C906
source "arch/riscv/c906/Kconfig"
endif
if CONFIG_E906
source "arch/riscv/e906/Kconfig"
endif
if CONFIG_E902
source "arch/riscv/e902/Kconfig"
endif
source "arch/riscv/lib/Kconfig"
```

## bms/arch/riscv/c906/Kconfig
```kconfig
config DRV_CORE_C906
	bool "core c906 support"
	default n
	help:
		enable core c906
```

## bms/arch/riscv/lib/Kconfig
```kconfig
config HW_MEMDEV
	bool "Support HW memcpy & memset"
	depends on COMPILE_RTL && (TB_RUN_DDR || TB_RUN_DDR1)
	default y
	help
	   Support HW memcpy & memset

config CCI_COHERENCY_EN
	bool "Enable CCI coherency for multi cluster"
	default n
	help
	   Enable CCI coherency
```

## bms/configs/c920/c920_rtl_ddr_mini_soc_defconfig
```kconfig
CONFIG_RISCV=y
CONFIG_C920=y
CONFIG_MACHINE="c920"
CONFIG_COMPILE_RTL=y
CONFIG_NR_CPUS=8
CONFIG_TB_RUN_DDR=y
CONFIG_CACHE=y
CONFIG_DCACHE=y
CONFIG_ICACHE=y
CONFIG_L2CACHE=y
CONFIG_64BIT=y
CONFIG_COMPILE_DRV=y
CONFIG_DRV_SYSM=y
CONFIG_DRV_IRQCHIP=y
CONFIG_PLIC=y
CONFIG_COMPILE_LIB=y
CONFIG_LIB_COMMAND=y
CONFIG_LIB_MATH=y
CONFIG_LIB_SHELL=y
CONFIG_LIB_STDLIB=y
CONFIG_LIB_CONSOLE=y
CONFIG_LIB_CRYPTO=y
CONFIG_LIB_COMMON=y
CONFIG_LIB_INTERRUPT=y
CONFIG_LIB_RTLFS=y
CONFIG_RTLFS_LOCATION=0x120000000
CONFIG_LIB_RTL=y
CONFIG_COMPILE_ARCH=y
CONFIG_HW_MEMDEV=y
```

## bms/configs/e906/e906_rtl_ddr_mini_soc_defconfig
```kconfig
CONFIG_RISCV=y
CONFIG_E906=y
CONFIG_MACHINE="e906"
CONFIG_COMPILE_RTL=y
CONFIG_NR_CPUS=1
CONFIG_TB_RUN_DDR=y
CONFIG_CACHE=y
CONFIG_DCACHE=y
CONFIG_ICACHE=y
CONFIG_CACHE_LITE=y
CONFIG_SYSMAP=y
CONFIG_32BIT=y
CONFIG_COMPILE_DRV=y
CONFIG_DRV_SYSM=y
CONFIG_DRV_IRQCHIP=y
CONFIG_CLIC=y
CONFIG_COMPILE_LIB=y
CONFIG_LIB_COMMAND=y
CONFIG_LIB_MATH=y
CONFIG_LIB_SHELL=y
CONFIG_LIB_STDLIB=y
CONFIG_LIB_CONSOLE=y
CONFIG_LIB_CRYPTO=y
CONFIG_LIB_COMMON=y
CONFIG_LIB_INTERRUPT=y
CONFIG_LIB_RTLFS=y
CONFIG_LIB_RTL=y
CONFIG_COMPILE_ARCH=y
CONFIG_HW_MEMDEV=y
```

## bms/drivers/Kconfig
```kconfig
source "drivers/dma/Kconfig"
source "drivers/sysm/Kconfig"
source "drivers/irqchip/Kconfig"
source "drivers/timer/Kconfig"
source "drivers/i2c/Kconfig"
source "drivers/eeprom/Kconfig"
source "drivers/wdt/Kconfig"
source "drivers/uart/Kconfig"
source "drivers/eth/Kconfig"
source "drivers/i2s/Kconfig"
source "drivers/sdmmc/Kconfig"
source "drivers/drd/Kconfig"
source "drivers/rtc/Kconfig"
source "drivers/spi/Kconfig"
source "drivers/xspi/Kconfig"
source "drivers/spi_flash/Kconfig"
source "drivers/mu/Kconfig"
source "drivers/pwm/Kconfig"
source "drivers/pvt/Kconfig"
source "drivers/cae/Kconfig"
source "drivers/pufcc/Kconfig"
source "drivers/ddr/Kconfig"
source "drivers/rxa/Kconfig"
source "drivers/lpddr4/Kconfig"
source "drivers/vdec/Kconfig"
source "drivers/ids/Kconfig"
source "drivers/dmic/Kconfig"
source "drivers/venc/Kconfig"
source "drivers/pmic/Kconfig"
source "drivers/dmic_pcm/Kconfig"
source "drivers/hwmon/Kconfig"
```

## bms/drivers/cae/Kconfig
```kconfig
config DRV_CAE
	bool "cae driver support"
	default n
	help:
	  enable cae

config DRV_CAE_IVP
	bool "ivp test"
	depends on DRV_CAE
	help
		Integration Vectors File test
```

## bms/drivers/dmic/Kconfig
```kconfig
config DRV_DMIC
	bool "dmic driver support"
	default n
	select DRV_DMA
	select TBH_DMA
	help:
		enable dmic driver
```

## bms/drivers/dmic_pcm/Kconfig
```kconfig
config DRV_DMIC_PCM
	bool "dmic_pcm driver support"
	default n
	select DRV_DMA
	select TBH_DMA
	help:
		enable dmic_pcm driver
```

## bms/drivers/eeprom/Kconfig
```kconfig
menuconfig DRV_EEPROM
	bool "eeprom driver support"
	default n
	help
		enable eeprom driver

if DRV_EEPROM
source "drivers/eeprom/microchip_24aa08/Kconfig"
endif
```
